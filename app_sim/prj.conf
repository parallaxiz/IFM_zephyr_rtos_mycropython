## CMakeLists.txt
```
cmake_minimum_required(VERSION 3.20.0)
find_package(Zephyr REQUIRED HINTS $ENV{ZEPHYR_BASE})
project(zephyr_micropython_app_sim)

set(COMMON_DIR          ${CMAKE_CURRENT_SOURCE_DIR}/../common)
set(MICROPY_PORT_DIR    ${COMMON_DIR}/micropython/ports/zephyr)
set(MICROPY_DIR         ${MICROPY_PORT_DIR}/../..)
set(MICROPY_OOFATFS_DIR ${MICROPY_DIR}/lib/oofatfs)
set(MICROPY_TARGET      app)

include(${MICROPY_DIR}/py/py.cmake)
include(${MICROPY_DIR}/extmod/extmod.cmake)

set(MICROPY_SOURCE_PORT
    ${MICROPY_PORT_DIR}/help.c
    ${MICROPY_PORT_DIR}/machine_pin.c
    ${MICROPY_PORT_DIR}/machine_i2c.c
    ${MICROPY_PORT_DIR}/machine_spi.c
    ${MICROPY_PORT_DIR}/machine_timer.c
    ${MICROPY_PORT_DIR}/mphalport.c
    ${MICROPY_PORT_DIR}/zephyr_device.c
    ${MICROPY_PORT_DIR}/zephyr_storage.c
    ${MICROPY_PORT_DIR}/mpthreadport.c
)

set(MICROPY_SOURCE_SHARED
    ${MICROPY_DIR}/drivers/bus/softspi.c
    ${MICROPY_DIR}/shared/libc/printf.c
    ${MICROPY_DIR}/shared/readline/readline.c
    ${MICROPY_DIR}/shared/runtime/gchelper_generic.c
    ${MICROPY_DIR}/shared/runtime/interrupt_char.c
    ${MICROPY_DIR}/shared/runtime/mpirq.c
    ${MICROPY_DIR}/shared/runtime/pyexec.c
    ${MICROPY_DIR}/shared/runtime/stdout_helpers.c
    ${MICROPY_DIR}/shared/runtime/sys_stdio_mphal.c
    ${MICROPY_DIR}/shared/timeutils/timeutils.c
)

set(MICROPY_SOURCE_QSTR
    ${CMAKE_CURRENT_SOURCE_DIR}/src/main.c
    ${CMAKE_CURRENT_SOURCE_DIR}/src/mod_simulator.c
    ${COMMON_DIR}/micropython_runner.c
    ${COMMON_DIR}/mp_port/mphalport.c
    ${MICROPY_SOURCE_PY}
    ${MICROPY_SOURCE_EXTMOD}
    ${MICROPY_SOURCE_SHARED}
    ${MICROPY_SOURCE_PORT}
)

target_sources(app PRIVATE
    ${MICROPY_SOURCE_QSTR}
    ${COMMON_DIR}/hw_hal.c
    ${COMMON_DIR}/mp_safety.c
    ${COMMON_DIR}/power_mgmt.c
    ${COMMON_DIR}/fault_log.c
)

target_include_directories(app PRIVATE
    src
    ${COMMON_DIR}
    ${COMMON_DIR}/mp_port
    ${MICROPY_PORT_DIR}
    ${MICROPY_DIR}
    ${MICROPY_INC_CORE}
    ${CMAKE_CURRENT_BINARY_DIR}
    ${CMAKE_CURRENT_BINARY_DIR}/genhdr
    ${CMAKE_CURRENT_BINARY_DIR}/zephyr/include/generated
    ${CMAKE_CURRENT_BINARY_DIR}/zephyr/include/generated/zephyr
)

target_compile_definitions(app PRIVATE
    NDEBUG
    MICROPY_HEAP_SIZE=49152
    FFCONF_H="${MICROPY_OOFATFS_DIR}/ffconf.h"
    asm=__asm__
)

target_compile_options(app PRIVATE
    -Wno-error=deprecated-declarations
    -Wno-deprecated-declarations
)

zephyr_get_include_directories_for_lang(C includes)
zephyr_get_system_include_directories_for_lang(C system_includes)
zephyr_get_compile_definitions_for_lang(C definitions)
zephyr_get_compile_options_for_lang(C options)

set(MICROPY_CPP_FLAGS_EXTRA -I${COMMON_DIR}/mp_port -I${COMMON_DIR} -I${CMAKE_CURRENT_SOURCE_DIR}/src -I${MICROPY_PORT_DIR} -I${MICROPY_DIR} -I${MICROPY_DIR}/py ${includes} ${system_includes} ${definitions} ${options} -Wno-error -Wno-deprecated-declarations -I${CMAKE_CURRENT_BINARY_DIR}/zephyr/include/generated/zephyr -I${CMAKE_CURRENT_BINARY_DIR}/zephyr/include/generated -DFFCONF_H="${MICROPY_OOFATFS_DIR}/ffconf.h" -Dasm=__asm__)

include(${MICROPY_DIR}/py/mkrules.cmake)

generate_inc_file_for_target(app ${CMAKE_CURRENT_SOURCE_DIR}/src/main.py ${CMAKE_CURRENT_BINARY_DIR}/main_py.inc)
```

## prj.conf
```kconfig
# Native Simulator Core Settings
CONFIG_PRINTK=y
CONFIG_MAIN_STACK_SIZE=4096
CONFIG_POLL=y
CONFIG_SERIAL=y
CONFIG_UART_CONSOLE=y
CONFIG_CONSOLE=y
CONFIG_CONSOLE_SUBSYS=y
CONFIG_CONSOLE_GETCHAR=y

# Native Simulator SDL Display & Graphic Drivers
CONFIG_DISPLAY=y
CONFIG_SDL_DISPLAY=y
CONFIG_CHARACTER_FRAMEBUFFER=y
CONFIG_LOG=y
```

## src/main.c
```c
#ifndef NO_QSTR
#include <zephyr/kernel.h>
#include <zephyr/sys/printk.h>
#include <zephyr/drivers/display.h>
#endif
#include <string.h>
#include <stdbool.h>
#include "micropython_runner.h"
#include "mod_simulator.h"

static const char main_py_script[] = {
#include "main_py.inc"
    0
};

int main(void)
{
    /* Initialize MicroPython VM environment */
    mp_runner_init();

    /* Run MicroPython runner test suite */
    mp_runner_test_stub();

    const struct device *display_dev = DEVICE_DT_GET(DT_CHOSEN(zephyr_display));

    if (!device_is_ready(display_dev)) {
        printk("Display device not ready!\n");
        mp_runner_deinit();
        return 0;
    }

    display_blanking_off(display_dev);
    printk("SDL Display initialized.\n");

    /* Pass the display device to the Python simulator module */
    simulator_set_display_device(display_dev);

    /* Run application script from main.py */
    mp_run_string(main_py_script);

    mp_runner_deinit();

    return 0;
}
```

## src/mod_simulator.c
```c
#include "mod_simulator.h"

#include <zephyr/kernel.h>
#include <zephyr/sys/printk.h>
#include <zephyr/drivers/display.h>

#include "py/runtime.h"
#include "py/obj.h"

#define RECT_SIZE       64
#define COLOR_GREEN     0xFF00E000u
#define COLOR_DARK_GREY 0xFF3C3C3Cu

static const struct device *sim_display_dev = NULL;
static uint32_t buf[RECT_SIZE * RECT_SIZE];

void simulator_set_display_device(const struct device *dev) {
    sim_display_dev = dev;
}

static void fill_rect_internal(uint16_t x, uint16_t y, uint16_t w, uint16_t h, uint32_t color) {
    if (!sim_display_dev) {
        return;
    }
    for (int i = 0; i < w * h && i < RECT_SIZE * RECT_SIZE; i++) {
        buf[i] = color;
    }

    struct display_buffer_descriptor desc = {
        .buf_size = w * h * sizeof(uint32_t),
        .width    = w,
        .height   = h,
        .pitch    = w,
    };

    display_write(sim_display_dev, x, y, &desc, buf);
}

static mp_obj_t mod_simulator_set_led(mp_obj_t state_in) {
    bool state = mp_obj_is_true(state_in);
    if (state) {
        printk("[SIMULATOR] LED: ON (Bright Green)\n");
        fill_rect_internal(128, 88, RECT_SIZE, RECT_SIZE, COLOR_GREEN);
    } else {
        printk("[SIMULATOR] LED: OFF (Dark Grey)\n");
        fill_rect_internal(128, 88, RECT_SIZE, RECT_SIZE, COLOR_DARK_GREY);
    }
    return mp_const_none;
}
static MP_DEFINE_CONST_FUN_OBJ_1(mod_simulator_set_led_obj, mod_simulator_set_led);

static mp_obj_t mod_simulator_sleep_ms(mp_obj_t ms_in) {
    mp_int_t ms = mp_obj_get_int(ms_in);
    if (ms > 0) {
        k_msleep(ms);
    }
    return mp_const_none;
}
static MP_DEFINE_CONST_FUN_OBJ_1(mod_simulator_sleep_ms_obj, mod_simulator_sleep_ms);

static const mp_rom_map_elem_t simulator_module_globals_table[] = {
    { MP_ROM_QSTR(MP_QSTR___name__), MP_ROM_QSTR(MP_QSTR_simulator) },
    { MP_ROM_QSTR(MP_QSTR_set_led), MP_ROM_PTR(&mod_simulator_set_led_obj) },
    { MP_ROM_QSTR(MP_QSTR_sleep_ms), MP_ROM_PTR(&mod_simulator_sleep_ms_obj) },
};
static MP_DEFINE_CONST_DICT(simulator_module_globals, simulator_module_globals_table);

const mp_obj_module_t mp_module_simulator = {
    .base = { &mp_type_module },
    .globals = (mp_obj_dict_t *)&simulator_module_globals,
};

MP_REGISTER_MODULE(MP_QSTR_simulator, mp_module_simulator);
```

## src/mod_simulator.h
```c
#ifndef MOD_SIMULATOR_H
#define MOD_SIMULATOR_H

#include <zephyr/device.h>

#ifdef __cplusplus
extern "C" {
#endif

void simulator_set_display_device(const struct device *dev);

#ifdef __cplusplus
}
#endif

#endif /* MOD_SIMULATOR_H */
```
