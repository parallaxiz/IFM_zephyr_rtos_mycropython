## app/testcase.yaml
```yaml
tests:
  micropython.zephyr.boot_test:
    tags:
      - micropython
      - zephyr
      - native_sim
    platform_allow:
      - native_sim
    harness: console
    harness_config:
      type: one_line
      regex:
        - "MicroPython initialized successfully"
```

## app_hardware/testcase.yaml
```yaml
tests:
  micropython.hardware.hal_and_runner:
    tags:
      - micropython
      - hardware
      - nrf5340
      - native_sim
    platform_allow:
      - native_sim
      - nrf5340dk/nrf5340/cpuapp
    harness: console
    harness_config:
      type: multi_line
      regex:
        - "HARDWARE BOOT"
        - "HAL Self-Test Starting"
        - "HAL Self-Test Complete"
        - "MicroPython initialized successfully"
        - "Entering script receive loop"
```

## app_sim/testcase.yaml
```yaml
tests:
  micropython.zephyr.boot_test:
    tags:
      - micropython
      - zephyr
      - native_sim
      - smoke
    platform_allow:
      - native_sim
    harness: console
    harness_config:
      type: multi_line
      regex:
        - "Booting Zephyr OS"
        - "MicroPython initialized successfully"

  micropython.zephyr.runner_test:
    tags:
      - micropython
      - execution
      - regression
      - native_sim
    platform_allow:
      - native_sim
    harness: console
    harness_config:
      type: multi_line
      regex:
        - "MicroPython initialized successfully"
        - "Test: MicroPython string runner working!"
        - "10 \\+ 20 = 30"
        - "ZeroDivisionError"
        - "Expected failure caught safely"
        - "SDL Display initialized."
```

## build/Kconfig/arch/Kconfig
```kconfig
# Load Zephyr Arch Kconfig descriptions.
osource "/home/ved/zephyr-workspace/zephyr/arch/rx/Kconfig"
osource "/home/ved/zephyr-workspace/zephyr/arch/x86/Kconfig"
osource "/home/ved/zephyr-workspace/zephyr/arch/xtensa/Kconfig"
osource "/home/ved/zephyr-workspace/zephyr/arch/sparc/Kconfig"
osource "/home/ved/zephyr-workspace/zephyr/arch/riscv/Kconfig"
osource "/home/ved/zephyr-workspace/zephyr/arch/posix/Kconfig"
osource "/home/ved/zephyr-workspace/zephyr/arch/openrisc/Kconfig"
osource "/home/ved/zephyr-workspace/zephyr/arch/mips/Kconfig"
osource "/home/ved/zephyr-workspace/zephyr/arch/arm64/Kconfig"
osource "/home/ved/zephyr-workspace/zephyr/arch/arm/Kconfig"
osource "/home/ved/zephyr-workspace/zephyr/arch/arc/Kconfig"
```

## build/Kconfig/boards/Kconfig
```kconfig
# Load Zephyr board Kconfig descriptions.
osource "/home/ved/zephyr-workspace/zephyr/boards/native/native_sim/Kconfig"
```

## build/Kconfig/boards/Kconfig.defconfig
```kconfig
# Load Zephyr board defconfig descriptions.
osource "/home/ved/zephyr-workspace/zephyr/boards/native/native_sim/Kconfig.defconfig"
```

## build/Kconfig/boards/Kconfig.native_sim
```kconfig
# Load board Kconfig descriptions.
osource "/home/ved/zephyr-workspace/zephyr/boards/native/native_sim/Kconfig.native_sim"
```
